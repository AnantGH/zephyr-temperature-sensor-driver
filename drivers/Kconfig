## drivers/temp_sensor/Kconfig
```kconfig
config CUSTOM_TEMP_SENSOR
    bool "Custom Temperature Sensor Driver"
    default n
    depends on GPIO
    help
      Enable the custom temperature sensor driver
```

## dts/bindings/input/guangzhou-pusheng,gx600.yaml
```yaml
description: Guangzhou Pu Sheng GX-600 NTC Thermistor assembly

compatible: "guangzhou-pusheng,gx600"

include: sensor-device.yaml

properties:
  io-channels:
    type: phandle-array
    required: true
    description: ADC channel connected to the analog temperature sensor signal pin.
```
